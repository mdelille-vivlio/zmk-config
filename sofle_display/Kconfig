## sofle_display/Kconfig
```kconfig
# Portrait status screen for the vertically mounted Sofle OLED.

config SOFLE_DISPLAY_STATUS
    bool "Sofle portrait status screen"
    default y if ZMK_DISPLAY_STATUS_SCREEN_CUSTOM
    select LV_USE_IMG
    select LV_USE_CANVAS
    select LV_FONT_MONTSERRAT_10
    select LV_FONT_MONTSERRAT_14

if SOFLE_DISPLAY_STATUS

config SOFLE_DISPLAY_ROTATION
    int "Rotation applied to each block, in tenths of a degree (900 or 2700)"
    default 900
    help
      Flip between 900 and 2700 if the screen reads upside down.

config SOFLE_DISPLAY_INVERTED
    bool "Draw dark text on a light background"

endif
```

## sofle_display/dts/bindings/sofle,behavior-boot-screen.yaml
```yaml
description: Draws a bootloader screen on the OLED, then reboots into the UF2 bootloader

compatible: "sofle,behavior-boot-screen"

include: zero_param.yaml
```
